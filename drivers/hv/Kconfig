## drivers/hv/Kconfig
```kconfig
# SPDX-License-Identifier: GPL-2.0

menu "Microsoft Hyper-V guest support"

config HYPERV
	tristate "Microsoft Hyper-V client drivers"
	depends on (X86 && X86_LOCAL_APIC && HYPERVISOR_GUEST) \
		|| (ACPI && ARM64 && !CPU_BIG_ENDIAN)
	select PARAVIRT
	select X86_HV_CALLBACK_VECTOR if X86
	select OF_EARLY_FLATTREE if OF
	help
	  Select this option to run Linux as a Hyper-V client operating
	  system.

config HYPERV_VTL_MODE
	bool "Enable Linux to boot in VTL context"
	depends on X86_64 && HYPERV
	depends on SMP
	default n
	help
	  Virtual Secure Mode (VSM) is a set of hypervisor capabilities and
	  enlightenments offered to host and guest partitions which enables
	  the creation and management of new security boundaries within
	  operating system software.

	  VSM achieves and maintains isolation through Virtual Trust Levels
	  (VTLs). Virtual Trust Levels are hierarchical, with higher levels
	  being more privileged than lower levels. VTL0 is the least privileged
	  level, and currently only other level supported is VTL2.

	  Select this option to build a Linux kernel to run at a VTL other than
	  the normal VTL0, which currently is only VTL2.  This option
	  initializes the x86 platform for VTL2, and adds the ability to boot
	  secondary CPUs directly into 64-bit context as required for VTLs other
	  than 0.  A kernel built with this option must run at VTL2, and will
	  not run as a normal guest.

	  If unsure, say N

config HYPERV_TIMER
	def_bool HYPERV && X86

config HYPERV_UTILS
	tristate "Microsoft Hyper-V Utilities driver"
	depends on HYPERV && CONNECTOR && NLS
	depends on PTP_1588_CLOCK_OPTIONAL
	help
	  Select this option to enable the Hyper-V Utilities.

config HYPERV_BALLOON
	tristate "Microsoft Hyper-V Balloon driver"
	depends on HYPERV
	select PAGE_REPORTING
	help
	  Select this option to enable Hyper-V Balloon driver.

config HYPERV_NONTLFS_HEADERS
	bool "Use hv*dk version of headers instead of hyperv-tlfs.h"
	default n
	depends on HYPERV
	help
	  This options specifies whether the kernel will be built
	  with hyper-tlfs.h or not. If unsure, say N.

config MSHV
	tristate "Microsoft Hypervisor root partition interfaces: /dev/mshv"
	depends on HYPERV
	select EVENTFD
	select MSHV_VFIO
	select MSHV_XFER_TO_GUEST_WORK
	default n
	help
	  Select this option to enable core functionality for managing guest
	  virtual machines running under the Microsoft Hypervisor.

	  The interfaces are provided via a device named /dev/mshv.

	  To compile this as a module, choose M here.

	  If unsure, say N.

config MSHV_ROOT
	tristate "Microsoft Hyper-V root partition APIs driver"
	depends on MSHV
	select HYPERV_NONTLFS_HEADERS
	help
	  Select this option to provide /dev/mshv interfaces specific to
	  running as the root partition on Microsoft Hypervisor.

	  To compile this as a module, choose M here.

	  If unsure, say N.

endmenu
```

## drivers/hv/diag/Kconfig
```kconfig
# SPDX-License-Identifier: GPL-2.0
# Configuration for diagnostics from mshv (mshv_diag)
#

config MSHV_DIAG
        tristate "Interface to get telemetry/diagnostics from mshv"
        depends on HYPERV
        help
          In a configuration with Linux as Root Partition, this driver
          exposes diagnostics/telemetry from Microsoft Hypervisor (mshv) to
          userpace.

          Diagnostics could include Diagnostic(error) Logs,
          Performance Tracing and System Event Logs.

          To compile this as a module, choose M here.

          If unsure, say N.
```

## virt/heki/Kconfig
```kconfig
# SPDX-License-Identifier: GPL-2.0
#
# Hypervisor Enforced Kernel Integrity (Heki)

menuconfig HEKI_MENU
	bool "Virtualization hardening"
if HEKI_MENU

config HEKI
	bool "Hypervisor Enforced Kernel Integrity (Heki)"
	help
	  This feature enhances guest virtual machine security by taking
	  advantage of security features provided by the hypervisor for guests.
	  This feature is helpful in maintaining guest virtual machine security
	  even after the guest kernel has been compromised.

config HEKI_KUNIT_TEST
	bool "KUnit tests for Heki" if !KUNIT_ALL_TESTS
	depends on KUNIT
	depends on X86
	depends on HEKI
	default KUNIT_ALL_TESTS
	help
	  Build KUnit tests for HEKI.
	  See the KUnit documentation in Documentation/dev-tools/kunit
	  If you are unsure how to answer this question, answer N.
endif
```
